## prj.conf
```kconfig
CONFIG_BT=y
CONFIG_BT_OBSERVER=y

# Same controller TX power setting as the HCI firmware under test, so the
# only variable between the two is the firmware/stack itself.
CONFIG_BT_CTLR_TX_PWR_PLUS_8=y

# Log RSSI over RTT (J-Link), leaving both UARTs untouched.
CONFIG_CONSOLE=y
CONFIG_RTT_CONSOLE=y
CONFIG_USE_SEGGER_RTT=y
CONFIG_UART_CONSOLE=n
CONFIG_SEGGER_RTT_BUFFER_SIZE_UP=4096
```

## src/observer.c
```c
/*
 * Copyright (c) 2022 Nordic Semiconductor ASA
 * Copyright (c) 2015-2016 Intel Corporation
 *
 * SPDX-License-Identifier: Apache-2.0
 */

#include <zephyr/sys/printk.h>
#include <zephyr/bluetooth/bluetooth.h>
#include <zephyr/bluetooth/hci.h>

static void device_found(const bt_addr_le_t *addr, int8_t rssi, uint8_t type,
			 struct net_buf_simple *ad)
{
	printk("Device found: %s (RSSI %d), type %u, AD data len %u\n",
	       bt_addr_le_str(addr), rssi, type, ad->len);
}

#if defined(CONFIG_BT_EXT_ADV)
#define NAME_LEN 30

static bool data_cb(struct bt_data *data, void *user_data)
{
	char *name = user_data;
	uint8_t len;

	switch (data->type) {
	case BT_DATA_NAME_SHORTENED:
	case BT_DATA_NAME_COMPLETE:
		len = MIN(data->data_len, NAME_LEN - 1);
		(void)memcpy(name, data->data, len);
		name[len] = '\0';
		return false;
	default:
		return true;
	}
}

static const char *phy2str(uint8_t phy)
{
	switch (phy) {
	case BT_GAP_LE_PHY_NONE: return "No packets";
	case BT_GAP_LE_PHY_1M: return "LE 1M";
	case BT_GAP_LE_PHY_2M: return "LE 2M";
	case BT_GAP_LE_PHY_CODED: return "LE Coded";
	default: return "Unknown";
	}
}

static void scan_recv(const struct bt_le_scan_recv_info *info,
		      struct net_buf_simple *buf)
{
	char name[NAME_LEN];
	uint8_t data_status;
	uint16_t data_len;

	(void)memset(name, 0, sizeof(name));

	data_len = buf->len;
	bt_data_parse(buf, data_cb, name);

	data_status = BT_HCI_LE_ADV_EVT_TYPE_DATA_STATUS(info->adv_props);

	printk("[DEVICE]: %s, AD evt type %u, Tx Pwr: %i, RSSI %i "
	       "Data status: %u, AD data len: %u Name: %s "
	       "C:%u S:%u D:%u SR:%u E:%u Pri PHY: %s, Sec PHY: %s, "
	       "Interval: 0x%04x (%u ms), SID: %u\n",
	       bt_addr_le_str(info->addr), info->adv_type, info->tx_power, info->rssi,
	       data_status, data_len, name,
	       (info->adv_props & BT_GAP_ADV_PROP_CONNECTABLE) != 0,
	       (info->adv_props & BT_GAP_ADV_PROP_SCANNABLE) != 0,
	       (info->adv_props & BT_GAP_ADV_PROP_DIRECTED) != 0,
	       (info->adv_props & BT_GAP_ADV_PROP_SCAN_RESPONSE) != 0,
	       (info->adv_props & BT_GAP_ADV_PROP_EXT_ADV) != 0,
	       phy2str(info->primary_phy), phy2str(info->secondary_phy),
	       info->interval, info->interval * 5 / 4, info->sid);
}

static struct bt_le_scan_cb scan_callbacks = {
	.recv = scan_recv,
};
#endif /* CONFIG_BT_EXT_ADV */

static int scan_start(void)
{
	/* Passive scan, no duplicate filtering, 30 ms window / 60 ms interval -
	 * matches what BlueZ configures on the HCI firmware under test, so the
	 * RSSI figures are directly comparable.
	 */
	struct bt_le_scan_param scan_param = {
		.type       = BT_LE_SCAN_TYPE_PASSIVE,
		.options    = BT_LE_SCAN_OPT_NONE,
		.interval   = 0x0060,
		.window     = 0x0030,
	};
	int err;

#if defined(CONFIG_BT_EXT_ADV)
	scan_param.options |= BT_LE_SCAN_OPT_CODED;
#endif /* CONFIG_BT_EXT_ADV */

scan_start_retry:
	printk("Starting scanning...\n");
	err = bt_le_scan_start(&scan_param, device_found);
	if (err) {
		if ((scan_param.options & BT_LE_SCAN_OPT_CODED) != 0U) {
			printk("Failed to start scanning with Coded PHY (err %d), retrying "
			       "without...\n", err);

			scan_param.options &= ~BT_LE_SCAN_OPT_CODED;

			goto scan_start_retry;
		}

		printk("Start scanning failed (err %d)\n", err);

		return err;
	}

	printk("success.\n");

	return 0;
}

int observer_start(void)
{
	int err;

#if defined(CONFIG_BT_EXT_ADV)
	bt_le_scan_cb_register(&scan_callbacks);
	printk("Registered scan callbacks\n");
#endif /* CONFIG_BT_EXT_ADV */

	err = scan_start();
	if (err != 0) {
		return err;
	}

	return 0;
}
```
